## build/Kconfig/soc/Kconfig
```kconfig
# Load Zephyr SoC Kconfig descriptions.
osource "/workdir/zephyrproject/zephyr/soc/xlnx/zynqmp/Kconfig"
osource "/workdir/zephyrproject/zephyr/soc/xlnx/zynq7000/Kconfig"
osource "/workdir/zephyrproject/zephyr/soc/xlnx/versalnet/Kconfig"
osource "/workdir/zephyrproject/zephyr/soc/xlnx/versal2/Kconfig"
osource "/workdir/zephyrproject/zephyr/soc/xlnx/versal/Kconfig"
osource "/workdir/zephyrproject/zephyr/soc/xen/Kconfig"
osource "/workdir/zephyrproject/zephyr/soc/wch/ch32v/Kconfig"
osource "/workdir/zephyrproject/zephyr/soc/ti/simplelink/Kconfig"
osource "/workdir/zephyrproject/zephyr/soc/ti/mspm/Kconfig"
osource "/workdir/zephyrproject/zephyr/soc/ti/lm3s6965/Kconfig"
osource "/workdir/zephyrproject/zephyr/soc/ti/k3/Kconfig"
osource "/workdir/zephyrproject/zephyr/soc/ti/am13/Kconfig"
osource "/workdir/zephyrproject/zephyr/soc/telink/tlsr/Kconfig"
osource "/workdir/zephyrproject/zephyr/soc/syna/sr100/Kconfig"
osource "/workdir/zephyrproject/zephyr/soc/starfive/jh71xx/Kconfig"
osource "/workdir/zephyrproject/zephyr/soc/st/stm32/Kconfig"
osource "/workdir/zephyrproject/zephyr/soc/snps/qemu_arc/Kconfig"
osource "/workdir/zephyrproject/zephyr/soc/snps/nsim/arc_v/Kconfig"
osource "/workdir/zephyrproject/zephyr/soc/snps/nsim/arc_classic/Kconfig"
osource "/workdir/zephyrproject/zephyr/soc/snps/hsdk4xd/Kconfig"
osource "/workdir/zephyrproject/zephyr/soc/snps/hsdk/Kconfig"
osource "/workdir/zephyrproject/zephyr/soc/snps/emsk/Kconfig"
osource "/workdir/zephyrproject/zephyr/soc/snps/emsdp/Kconfig"
osource "/workdir/zephyrproject/zephyr/soc/snps/arc_iot/Kconfig"
osource "/workdir/zephyrproject/zephyr/soc/silabs/Kconfig"
osource "/workdir/zephyrproject/zephyr/soc/sifli/sf32/Kconfig"
osource "/workdir/zephyrproject/zephyr/soc/sifive/sifive_freedom/Kconfig"
osource "/workdir/zephyrproject/zephyr/soc/shakti/Kconfig"
osource "/workdir/zephyrproject/zephyr/soc/sensry/Kconfig"
osource "/workdir/zephyrproject/zephyr/soc/rockchip/Kconfig"
osource "/workdir/zephyrproject/zephyr/soc/renode/riscv_virtual/Kconfig"
osource "/workdir/zephyrproject/zephyr/soc/renode/cortex_r8_virtual/Kconfig"
osource "/workdir/zephyrproject/zephyr/soc/renesas/smartbond/Kconfig"
osource "/workdir/zephyrproject/zephyr/soc/renesas/rz/Kconfig"
osource "/workdir/zephyrproject/zephyr/soc/renesas/rx/Kconfig"
osource "/workdir/zephyrproject/zephyr/soc/renesas/rcar/Kconfig"
osource "/workdir/zephyrproject/zephyr/soc/renesas/ra/Kconfig"
osource "/workdir/zephyrproject/zephyr/soc/realtek/fingerprint/Kconfig"
osource "/workdir/zephyrproject/zephyr/soc/realtek/ec/Kconfig"
osource "/workdir/zephyrproject/zephyr/soc/realtek/bee/Kconfig"
osource "/workdir/zephyrproject/zephyr/soc/realtek/ameba/Kconfig"
osource "/workdir/zephyrproject/zephyr/soc/raspberrypi/rpi_pico/Kconfig"
osource "/workdir/zephyrproject/zephyr/soc/quicklogic/eos_s3/Kconfig"
osource "/workdir/zephyrproject/zephyr/soc/qemu/virt_riscv/Kconfig"
osource "/workdir/zephyrproject/zephyr/soc/qemu/or1k/Kconfig"
osource "/workdir/zephyrproject/zephyr/soc/qemu/malta/Kconfig"
osource "/workdir/zephyrproject/zephyr/soc/openisa/rv32m1/Kconfig"
osource "/workdir/zephyrproject/zephyr/soc/openhwgroup/cva6/Kconfig"
osource "/workdir/zephyrproject/zephyr/soc/oct/osd32mp15x/Kconfig"
osource "/workdir/zephyrproject/zephyr/soc/nxp/s32/Kconfig"
osource "/workdir/zephyrproject/zephyr/soc/nxp/rw/Kconfig"
osource "/workdir/zephyrproject/zephyr/soc/nxp/mcx/Kconfig"
osource "/workdir/zephyrproject/zephyr/soc/nxp/lpc/Kconfig"
osource "/workdir/zephyrproject/zephyr/soc/nxp/layerscape/Kconfig"
osource "/workdir/zephyrproject/zephyr/soc/nxp/kinetis/Kconfig"
osource "/workdir/zephyrproject/zephyr/soc/nxp/imxrt/Kconfig"
osource "/workdir/zephyrproject/zephyr/soc/nxp/imx/Kconfig"
osource "/workdir/zephyrproject/zephyr/soc/nuvoton/numicro/Kconfig"
osource "/workdir/zephyrproject/zephyr/soc/nuvoton/numaker/Kconfig"
osource "/workdir/zephyrproject/zephyr/soc/nuvoton/npcx/Kconfig"
osource "/workdir/zephyrproject/zephyr/soc/nuvoton/npcm/Kconfig"
osource "/workdir/zephyrproject/zephyr/soc/nordic/Kconfig"
osource "/workdir/zephyrproject/zephyr/soc/neorv32/Kconfig"
osource "/workdir/zephyrproject/zephyr/soc/native/inf_clock/Kconfig"
osource "/workdir/zephyrproject/zephyr/soc/microchip/smartfusion2/Kconfig"
osource "/workdir/zephyrproject/zephyr/soc/microchip/sam/sama7/Kconfig"
osource "/workdir/zephyrproject/zephyr/soc/microchip/sam/sam_d5x_e5x/Kconfig"
osource "/workdir/zephyrproject/zephyr/soc/microchip/pic64/Kconfig"
osource "/workdir/zephyrproject/zephyr/soc/microchip/pic32c/pic32cz_ca/Kconfig"
osource "/workdir/zephyrproject/zephyr/soc/microchip/pic32c/pic32cx_sg/Kconfig"
osource "/workdir/zephyrproject/zephyr/soc/microchip/pic32c/pic32cm_sg_gc/Kconfig"
osource "/workdir/zephyrproject/zephyr/soc/microchip/pic32c/pic32cm_pl/Kconfig"
osource "/workdir/zephyrproject/zephyr/soc/microchip/pic32c/pic32cm_jh/Kconfig"
osource "/workdir/zephyrproject/zephyr/soc/microchip/pic32c/pic32ck_sg_gc/Kconfig"
osource "/workdir/zephyrproject/zephyr/soc/microchip/miv/Kconfig"
osource "/workdir/zephyrproject/zephyr/soc/microchip/mec/Kconfig"
osource "/workdir/zephyrproject/zephyr/soc/mediatek/mt8xxx/Kconfig"
osource "/workdir/zephyrproject/zephyr/soc/lowrisc/opentitan/Kconfig"
osource "/workdir/zephyrproject/zephyr/soc/litex/Kconfig"
osource "/workdir/zephyrproject/zephyr/soc/ite/ec/Kconfig"
osource "/workdir/zephyrproject/zephyr/soc/intel/wildcat_lake/Kconfig"
osource "/workdir/zephyrproject/zephyr/soc/intel/raptor_lake/Kconfig"
osource "/workdir/zephyrproject/zephyr/soc/intel/panther_lake/Kconfig"
osource "/workdir/zephyrproject/zephyr/soc/intel/nova_lake/Kconfig"
osource "/workdir/zephyrproject/zephyr/soc/intel/lakemont/Kconfig"
osource "/workdir/zephyrproject/zephyr/soc/intel/intel_socfpga_std/Kconfig"
osource "/workdir/zephyrproject/zephyr/soc/intel/intel_socfpga/Kconfig"
osource "/workdir/zephyrproject/zephyr/soc/intel/intel_niosv/Kconfig"
osource "/workdir/zephyrproject/zephyr/soc/intel/intel_ish/Kconfig"
osource "/workdir/zephyrproject/zephyr/soc/intel/intel_adsp/Kconfig"
osource "/workdir/zephyrproject/zephyr/soc/intel/elkhart_lake/Kconfig"
osource "/workdir/zephyrproject/zephyr/soc/intel/atom/Kconfig"
osource "/workdir/zephyrproject/zephyr/soc/intel/apollo_lake/Kconfig"
osource "/workdir/zephyrproject/zephyr/soc/intel/alder_lake/Kconfig"
osource "/workdir/zephyrproject/zephyr/soc/infineon/psoc4/Kconfig"
osource "/workdir/zephyrproject/zephyr/soc/infineon/edge/Kconfig"
osource "/workdir/zephyrproject/zephyr/soc/infineon/cat3/Kconfig"
osource "/workdir/zephyrproject/zephyr/soc/infineon/cat1c/Kconfig"
osource "/workdir/zephyrproject/zephyr/soc/infineon/cat1b/Kconfig"
osource "/workdir/zephyrproject/zephyr/soc/infineon/cat1a/Kconfig"
osource "/workdir/zephyrproject/zephyr/soc/gd/gd32/Kconfig"
osource "/workdir/zephyrproject/zephyr/soc/gaisler/leon3/Kconfig"
osource "/workdir/zephyrproject/zephyr/soc/gaisler/gr716a/Kconfig"
osource "/workdir/zephyrproject/zephyr/soc/focaltech/Kconfig"
osource "/workdir/zephyrproject/zephyr/soc/espressif/Kconfig"
osource "/workdir/zephyrproject/zephyr/soc/ene/kb1200/Kconfig"
osource "/workdir/zephyrproject/zephyr/soc/ene/kb106x/Kconfig"
osource "/workdir/zephyrproject/zephyr/soc/elan/em32f967/Kconfig"
osource "/workdir/zephyrproject/zephyr/soc/egis/Kconfig"
osource "/workdir/zephyrproject/zephyr/soc/efinix/sapphire/Kconfig"
osource "/workdir/zephyrproject/zephyr/soc/cdns/xtensa_sample_controller/Kconfig"
osource "/workdir/zephyrproject/zephyr/soc/cdns/swerv/Kconfig"
osource "/workdir/zephyrproject/zephyr/soc/cdns/sample_controller32/Kconfig"
osource "/workdir/zephyrproject/zephyr/soc/cdns/dc233c/Kconfig"
osource "/workdir/zephyrproject/zephyr/soc/brcm/bcmvk/Kconfig"
osource "/workdir/zephyrproject/zephyr/soc/brcm/bcm2712/Kconfig"
osource "/workdir/zephyrproject/zephyr/soc/brcm/bcm2711/Kconfig"
osource "/workdir/zephyrproject/zephyr/soc/blackberry/qnxhv_vm/Kconfig"
osource "/workdir/zephyrproject/zephyr/soc/bflb/Kconfig"
osource "/workdir/zephyrproject/zephyr/soc/atmel/sam0/Kconfig"
osource "/workdir/zephyrproject/zephyr/soc/atmel/sam/Kconfig"
osource "/workdir/zephyrproject/zephyr/soc/aspeed/Kconfig"
osource "/workdir/zephyrproject/zephyr/soc/arm/Kconfig"
osource "/workdir/zephyrproject/zephyr/soc/arm/beetle/Kconfig"
osource "/workdir/zephyrproject/zephyr/soc/antmicro/myra/Kconfig"
osource "/workdir/zephyrproject/zephyr/soc/andestech/Kconfig"
osource "/workdir/zephyrproject/zephyr/soc/amd/acp_7_x/Kconfig"
osource "/workdir/zephyrproject/zephyr/soc/amd/acp_7_0/Kconfig"
osource "/workdir/zephyrproject/zephyr/soc/amd/acp_6_0/Kconfig"
osource "/workdir/zephyrproject/zephyr/soc/ambiq/Kconfig"
osource "/workdir/zephyrproject/zephyr/soc/allwinner/sun8i_h3/Kconfig"
osource "/workdir/zephyrproject/zephyr/soc/allwinner/sun50i_h618/Kconfig"
osource "/workdir/zephyrproject/zephyr/soc/alif/ensemble/Kconfig"
osource "/workdir/zephyrproject/zephyr/soc/alif/balletto/Kconfig"
osource "/workdir/zephyrproject/zephyr/soc/aesc/Kconfig"
osource "/workdir/zephyrproject/zephyr/soc/adi/max32/Kconfig"
```
